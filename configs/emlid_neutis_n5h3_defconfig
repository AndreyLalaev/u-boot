## configs/emlid_neutis_n5h3_defconfig
```kconfig
CONFIG_ARM=y
CONFIG_ARCH_SUNXI=y
CONFIG_SPL=y
CONFIG_MACH_SUN8I_H3=y
CONFIG_DRAM_CLK=408
CONFIG_DRAM_ZQ=3881979
CONFIG_DRAM_ODT_EN=y
CONFIG_BOOTDELAY=5
# CONFIG_PINCTRL is not set
# CONFIG_VIDEO_DE2 is not set
CONFIG_DEFAULT_DEVICE_TREE="sun8i-h3-emlid-neutis-n5h3-devboard"
CONFIG_MMC_SUNXI_SLOT_EXTRA=2
CONFIG_OF_LIBFDT_OVERLAY=y
CONFIG_SHOW_ERRORS=y
# CONFIG_SYS_MALLOC_CLEAR_ON_INIT is not set
# CONFIG_CMD_FLASH is not set
# CONFIG_SPL_DOS_PARTITION is not set
# CONFIG_SPL_EFI_PARTITION is not set
CONFIG_SUPPORT_EMMC_BOOT=y
CONFIG_VERSION_VARIABLE=y
```
