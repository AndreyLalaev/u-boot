#include <cv1800b-milkv-duo.dts>

/ {
	model = "Milk-V Duo 256M";

        memory@80000000 {
                device_type = "memory";
		reg = <0x80000000 0xFE00000>;
        };
};

&sdhci0{
	compatible = "sophgo,cv1800b-dwcmshc";
	no-1-8-v;
};
